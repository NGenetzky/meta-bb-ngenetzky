## conf/bblayers.conf
```bitbake
BBPATH := "${TOPDIR}"
BBFILES ?= ""
BBLAYERS = "\
  ${TOPDIR}/layers/meta-r0-base \
  ${TOPDIR}/layers/meta-r0-base/meta-examples \
  ${TOPDIR}/layers/meta-r1-bb \
  ${TOPDIR}/layers/meta-r1-bb/meta-examples/ \
  "
```

## layers/meta-r0/conf/layer.conf
```bitbake
# We have a conf and classes directory, add to BBPATH
BBPATH .= ":${LAYERDIR}"

# We do not have recipes.
# BBFILES += "\
# "

# We do not have recipes to put in a collection
# BBFILE_COLLECTIONS += "ngenetzky-r0"
# BBFILE_PATTERN_ngenetzky-r0 = "^${LAYERDIR}/"
# BBFILE_PRIORITY_ngenetzky-r0 = "6"
```

## layers/meta-r0/meta-examples/conf/layer.conf
```bitbake
# We do not have a conf and classes directory
# BBPATH .= ":${LAYERDIR}"

# We have recipes, add to BBFILES
BBFILES += "\
${LAYERDIR}/*.bb \
"

BBFILE_COLLECTIONS += "ngenetzky-r0-examples"
BBFILE_PATTERN_ngenetzky-r0-examples = "^${LAYERDIR}/"
BBFILE_PRIORITY_ngenetzky-r0-examples = "6"
```

## layers/meta-r1-bb/conf/layer.conf
```bitbake
# We have a conf and classes directory, add to BBPATH
BBPATH .= ":${LAYERDIR}"

# We do not have recipes.
# BBFILES += "\
# "

# We do not have recipes to put in a collection
# BBFILE_COLLECTIONS += "ngenetzky-r1-bb"
# BBFILE_PATTERN_ngenetzky-r1-bb = "^${LAYERDIR}/"
# BBFILE_PRIORITY_ngenetzky-r1-bb = "6"
```

## layers/meta-r2-bitbake-yocto/conf/layer.conf
```bitbake
# We have a conf and classes directory, add to BBPATH
BBPATH .= ":${LAYERDIR}"

# We have recipes, add to BBFILES
BBFILES += "\
${LAYERDIR}/recipes-bitbake/*/*.bb \
"

# We have recipes, add to single collection
BBFILE_COLLECTIONS += "ngenetzky-r2-bitbake-yocto"
BBFILE_PATTERN_ngenetzky-r2-bitbake-yocto = "^${LAYERDIR}/"
BBFILE_PRIORITY_ngenetzky-r2-bitbake-yocto = "6"
```

## layers/meta-r2-venv/conf/layer.conf
```bitbake
# We do not have a conf and classes directory.
# BBPATH .= ":${LAYERDIR}"

BBFILES += "\
${LAYERDIR}/recipes-*/*.bb \
"

# We do not have recipes to put in a collection
BBFILE_COLLECTIONS += "ngenetzky-r2-venv"
BBFILE_PATTERN_ngenetzky-r2-venv = "^${LAYERDIR}/"
BBFILE_PRIORITY_ngenetzky-r2-venv = "6"
```

## meta-r0-base/conf/layer.conf
```bitbake
# https://gitlab.com/ngenetzky/meta-bb-project-base
LAYERSERIES_CORENAMES_append = " 734fb250-c268-11ea-9adc-5986b46143b2"

# layer has conf or classes directory, append to BBPATH
# BBPATH .= ":${LAYERDIR}"

# layer has conf or classes directory, prepend to BBPATH
BBPATH =. "${LAYERDIR}:"
```

## meta-r0-base/meta-examples/conf/layer.conf
```bitbake
# We do not have a conf and classes directory
# BBPATH .= ":${LAYERDIR}"

# We have example recipes right in LAYERDIR.
BBFILES += "${LAYERDIR}/*.bb"

# https://gitlab.com/ngenetzky/meta-bb-project-base
LAYERSERIES_COMPAT_r0-base-examples = "734fb250-c268-11ea-9adc-5986b46143b2"

BBFILE_COLLECTIONS += "r0-base-examples"
BBFILE_PATTERN_r0-base-examples = "^${LAYERDIR}/"
BBFILE_PRIORITY_r0-base-examples = "6"
```

## meta-r0-minimal/conf/layer.conf
```bitbake
# https://gitlab.com/ngenetzky/meta-bb-project-base
LAYERSERIES_CORENAMES = "734fb250-c268-11ea-9adc-5986b46143b2"

# We have a conf and classes directories, add to BBPATH
BBPATH .= "\
:${LAYERDIR}/meta-conf-bitbake/\
:${LAYERDIR}/meta-classes-base/\
"
```

## meta-r1-bb/conf/layer.conf
```bitbake
# We have a conf and classes directory, add to BBPATH
BBPATH .= ":${LAYERDIR}"

# Add basic 'bb' classes to existing core layer
LAYERSERIES_CORENAMES_append = " 734fb250-c268-11ea-9adc-5986b46143b2 "

# We do not have recipes.
# BBFILES += "\
# "

# We do not have recipes to put in a collection
# BBFILE_COLLECTIONS += "ngenetzky-r1-bb"
# BBFILE_PATTERN_ngenetzky-r1-bb = "^${LAYERDIR}/"
# BBFILE_PRIORITY_ngenetzky-r1-bb = "6"
```

## meta-r1-bb/meta-examples/conf/layer.conf
```bitbake
# We do not have a conf and classes directory.
# BBPATH .= ":${LAYERDIR}"

# We have example recipes right in LAYERDIR.
BBFILES += "${LAYERDIR}/*.bb"

# https://gitlab.com/ngenetzky/meta-bb-project-base
LAYERSERIES_COMPAT_r1-bb-examples = "734fb250-c268-11ea-9adc-5986b46143b2"

# We do not have recipes to put in a collection
BBFILE_COLLECTIONS += "r1-bb-examples"
BBFILE_PATTERN_r1-bb-examples = "^${LAYERDIR}/"
BBFILE_PRIORITY_r1-bb-examples = "6"
```

## meta-r2-bitbake-yocto/conf/layer.conf
```bitbake
# We have a conf and classes directory, add to BBPATH
BBPATH .= ":${LAYERDIR}"

# We have recipes, add to BBFILES
BBFILES += "\
${LAYERDIR}/recipes-bitbake/*/*.bb \
"

# https://gitlab.com/ngenetzky/meta-bb-project-base
LAYERSERIES_COMPAT_r2-bitbake-yocto = "734fb250-c268-11ea-9adc-5986b46143b2"

# We have recipes, add to single collection
BBFILE_COLLECTIONS += "r2-bitbake-yocto"
BBFILE_PATTERN_r2-bitbake-yocto = "^${LAYERDIR}/"
BBFILE_PRIORITY_r2-bitbake-yocto = "6"
```

## meta-r2-docker-build/conf/layer.conf
```bitbake
# We have a conf and classes directory, add to BBPATH
BBPATH .= ":${LAYERDIR}"

# https://gitlab.com/ngenetzky/meta-bb-project-base
LAYERSERIES_COMPAT_r2-docker-build = "734fb250-c268-11ea-9adc-5986b46143b2"
```

## meta-r2-docker-build/meta-examples/conf/layer.conf
```bitbake
# We have example recipes in LAYERDIR and one layer deep
BBFILES += "\
${LAYERDIR}/*.bb \
${LAYERDIR}/*/*.bb \
"

# https://gitlab.com/ngenetzky/meta-bb-project-base
LAYERSERIES_COMPAT_r2-docker-build = "734fb250-c268-11ea-9adc-5986b46143b2"

BBFILE_COLLECTIONS += "r2-docker-build"
BBFILE_PATTERN_r2-docker-build = "^${LAYERDIR}/"
BBFILE_PRIORITY_r2-docker-build = "6"
```

## meta-r2-gitlabci/meta-examples/conf/layer.conf
```bitbake
# We have example recipes in LAYERDIR and one layer deep
BBFILES += "\
${LAYERDIR}/*.bb \
${LAYERDIR}/*/*.bb \
"

# https://gitlab.com/ngenetzky/meta-bb-project-base
LAYERSERIES_COMPAT_r2-gitlabci-examples = "734fb250-c268-11ea-9adc-5986b46143b2"

BBFILE_COLLECTIONS += "r2-gitlabci-examples"
BBFILE_PATTERN_r2-gitlabci-examples = "^${LAYERDIR}/"
BBFILE_PRIORITY_r2-gitlabci-examples = "6"
```

## meta-r2-venv/conf/layer.conf
```bitbake
BBPATH .= ":${LAYERDIR}"

BBFILES += "\
${LAYERDIR}/recipes-*/*/*.bb \
"

BBFILE_COLLECTIONS += "r2-venv"
BBFILE_PATTERN_r2-venv = "^${LAYERDIR}/"
BBFILE_PRIORITY_r2-venv = "6"
```

## test/meta-r1-test-minimal/conf/layer.conf
```bitbake
# We have recipes-* directories, add to BBFILES
BBFILES += "${LAYERDIR}/recipes-*/*/*.bb"
```

## test/r1-test-minimal/conf/bblayers.conf
```bitbake
BBPATH := ""
BBFILES ?= ""
BBLAYERS = "\
 ${TOPDIR}/../../meta-r0-minimal/\
 ${TOPDIR}/meta-r1-test-minimal/\
"
```

## workspace/conf/layer.conf
```bitbake
# We have a conf and classes directory, add to BBPATH
BBPATH .= ":${LAYERDIR}"

# We have recipes, add to BBFILES
BBFILES += "${LAYERDIR}/recipes/*.bb"
```
